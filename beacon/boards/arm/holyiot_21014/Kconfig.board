## beacon/boards/arm/holyiot_21014/Kconfig.board
```kconfig
# nRF52 DK nRF52810 board configuration

# Copyright (c) 2018 Nordic Semiconductor ASA
# SPDX-License-Identifier: Apache-2.0

config BOARD_HOLYIOT_21014
	bool "Holyiot 21014"
	depends on SOC_NRF52810_QFAA
```

## beacon/boards/arm/holyiot_21014/Kconfig.defconfig
```kconfig
# nRF52 DK nRF52810 board configuration

# Copyright (c) 2018 Nordic Semiconductor ASA
# SPDX-License-Identifier: Apache-2.0

if BOARD_HOLYIOT_21014

config BOARD
	default "holyiot_21014"

endif # BOARD_HOLYIOT_21014
```

## beacon/boards/arm/holyiot_21014/holyiot_21014_defconfig
```kconfig
# SPDX-License-Identifier: Apache-2.0

CONFIG_SOC_SERIES_NRF52X=y
CONFIG_SOC_NRF52810_QFAA=y
CONFIG_BOARD_HOLYIOT_21014=y

# Enable MPU
CONFIG_ARM_MPU=y

# Enable hardware stack protection
CONFIG_HW_STACK_PROTECTION=y

# additional board options
CONFIG_GPIO_AS_PINRESET=y

CONFIG_PINCTRL=y

CONFIG_SENSOR=y
CONFIG_SPI=y
CONFIG_GPIO=y
CONFIG_LIS2DH=y
CONFIG_LIS2DH_TRIGGER_GLOBAL_THREAD=y
CONFIG_LIS2DH_ODR_1=y

CONFIG_BOARD_ENABLE_DCDC=y

# Bluetooth not enabled by default on nRF52810 due to RAM limitations when
# running the default set of kernel tests.
# Enable this on your prj.conf to include Bluetooth support
```
